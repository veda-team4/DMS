/dts-v1/;
/plugin/;

/ {
    compatible = "brcm,bcm2835";

    fragment@0 {
        target = <&i2c1>;
        __overlay__ {
            #address-cells = <1>;
            #size-cells = <0>;

            scd4x@62 {
                compatible = "dms,scd4x";
                reg = <0x62>;
            };
        };
    };
};
